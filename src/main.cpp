/*
   SX1276 LBJ Message Receive Project
   Migrated by FLN1021 on Sep 2023.
   Modified from RadioLib Pager (POCSAG) Receive Example.
   Original file:
   https://github.com/jgromes/RadioLib/blob/master/examples/Pager/Pager_Receive/Pager_Receive.ino
*/
/*
   RadioLib Pager (POCSAG) Receive Example

   This example shows how to receive FSK packets without using
   SX127x packet engine.

   This example receives POCSAG messages using SX1278's
   FSK modem in direct mode.

   Other modules that can be used to receive POCSAG:
    - SX127x/RFM9x
    - RF69
    - SX1231
    - CC1101
    - Si443x/RFM2x

   For default module settings, see the wiki page
   https://github.com/jgromes/RadioLib/wiki/Default-configuration#sx127xrfm9x---lora-modem

   For full API reference, see the GitHub Pages
   https://jgromes.github.io/RadioLib/
*/
/*
   Chinses Railway LBJ Signal Reciver Create by Brumaire_027 & ChatGPT in Sep 2026
   Used ESP32 + SX1276 Model
   Thanks for FLN1021's Original Program & JLC Inc.
*/

//Program Start

#pragma execution_character_set("utf-8")

// include libraries
#include <RadioLib.h>
#include "buttons.hpp"
#include "buzzer.hpp"
#include "coredump.h"
#include "customfont.h"
#include "data_formatter.hpp"
#include "debug_log.hpp"
#include "history_viewer.hpp"
#include "indicator_led.hpp"
#include "menu_system.hpp"
#include "network_menu.hpp"
#include "receiver_control.hpp"
#include "runtime_settings.hpp"
#include "serial_commands.hpp"
#include "recording_health.hpp"
#include "status_display.hpp"
#include "display_power.hpp"
#include "use_mode.hpp"
#include "storage_paths.hpp"
#include "task_state.hpp"
#include <esp_task_wdt.h>

#include <WiFiManager.h>

// configure the wifi connection
String wifiSSID = "ABCDE";
String wifiPassword = "123456789";
#define NETWORK_TIMEOUT 600000 // 10 minutes

#define WDT_TIMEOUT 20 // sec
// #define WDT_RST_PERIOD 4000 // ms
#define FD_TASK_STACK_SIZE 3000 // 68200
#define FD_TASK_TIMEOUT 750 // ms
#define FD_TASK_ATTEMPTS 3
//region Variables
SX1276 radio = new Module(RADIO_CS_PIN, RADIO_DIO0_PIN, RADIO_RST_PIN, RADIO_DIO1_PIN, SPI);
// receiving packets requires connection
// to the module direct output pin
const int pin = RADIO_BUSY_PIN;
float rssi_cache = 0;
// float fer = 0;
float fers[32]{};
float actual_frequency = 0;
float freq_last = 0;
float car_fer_last = 0;
// create Pager client instance using the FSK module
PagerClient pager(&radio);
// timers
uint64_t format_task_timer = 0;
uint64_t runtime_timer = 0;
uint64_t screen_timer = 0;
uint64_t timer4 = 0;
// uint64_t wdt_timer = 0;
uint64_t net_timer = 0;
uint64_t prb_timer = 0;
uint64_t car_timer = 0;
uint32_t prb_count = 0;
uint32_t car_count = 0;
uint32_t ip_last = 0;
float ppm = INITIAL_PPM;

WiFiManager wm;
bool is_ap_active = false;       // 标记是否处于 AP 配网模式

bool freq_correction = AFC_ENABLE;
// bool bandwidth_altered = false;
bool is_startline = true;
bool exec_init_f80 = false;
// bool agc_triggered = false;
bool low_volt_warned = false;
bool oled_off = false;
bool give_tel_rssi = false;
bool give_tel_gain = false;
bool tel_set_ppm = false;
bool no_wifi = false;
bool have_cd = false;
bool telnet_online = false;
SD_LOG sd1;
struct rx_info rxInfo;
static struct data_bond db_storage;
struct data_bond *db = nullptr;
// PagerClient::pocsag_data *pd = nullptr;
//endregion

//region Functions
void formatDataTask(void *pVoid);

void simpleFormatTask();

void initFmtVars();

TaskHandle_t task_fd;
std::atomic<task_states> fd_state{TASK_INIT};

void dualPrintf(bool time_stamp, const char *format, ...) { // Generated by ChatGPT.
    tm stamp{};
    char buffer[256]; // 创建一个足够大的缓冲区来容纳格式化后的字符串
    va_list args;
    va_start(args, format);
    vsnprintf(buffer, sizeof(buffer), format, args); // 格式化字符串
    va_end(args);

    // 输出到 Serial
    Serial.print(buffer);

    // 输出到 Telnet
    if (telnet_online) { // code from Multimon-NG unixinput.c 还得是multimon-ng，chatGPT写了四五个版本都没解决。
        if (is_startline) {
            telnet.print("\r> ");
            if (time_stamp && getValidLocalTime(&stamp))
                telnet.printf("\r%d-%02d-%02d %02d:%02d:%02d > ", stamp.tm_year + 1900, stamp.tm_mon + 1,
                              stamp.tm_mday, stamp.tm_hour, stamp.tm_min, stamp.tm_sec);
            is_startline = false;
        }
        telnet.print(buffer);
        if (nullptr != strchr(buffer, '\n')) {
            is_startline = true;
            telnet.print("\r< ");
        }
    }
}

void dualPrint(const char *fmt) {
    Serial.print(fmt);
    telnet.print(fmt);
}

void dualPrintln(const char *fmt) {
    Serial.println(fmt);
    telnet.println(fmt);
}

String printResetReason(esp_reset_reason_t reset) {
    String str;
    switch (reset) {
        case ESP_RST_UNKNOWN:
            str = "ESP_RST_UNKNOWN, Reset reason can not be determined";
            break;
        case ESP_RST_POWERON:
            str = "ESP_RST_POWERON, Reset due to power-on event";
            break;
        case ESP_RST_EXT:
            str = "ESP_RST_EXT, Reset by external pin (not applicable for ESP32)";
            break;
        case ESP_RST_SW:
            str = "ESP_RST_SW, Software reset via esp_restart";
            break;
        case ESP_RST_PANIC:
            str = "ESP_RST_PANIC, Software reset due to exception/panic";
            break;
        case ESP_RST_INT_WDT:
            str = "ESP_RST_INT_WDT, Reset (software or hardware) due to interrupt watchdog";
            break;
        case ESP_RST_TASK_WDT:
            str = "ESP_RST_TASK_WDT, Reset due to task watchdog";
            break;
        case ESP_RST_WDT:
            str = "ESP_RST_WDT, Reset due to other watchdogs";
            break;
        case ESP_RST_DEEPSLEEP:
            str = "ESP_RST_DEEPSLEEP, Reset after exiting deep sleep mode";
            break;
        case ESP_RST_BROWNOUT:
            str = "ESP_RST_BROWNOUT, Brownout reset (software or hardware)";
            break;
        case ESP_RST_SDIO:
            str = "ESP_RST_SDIO, Reset over SDIO";
            break;
    }
    return str;
}

void LBJTEST() {
    PagerClient::pocsag_data pocdat[16];
    pocdat[0].str = "37012";
    pocdat[0].addr = 1234000;
    pocdat[0].func = 1;
    pocdat[0].is_empty = false;
    pocdat[0].len = 15;
    pocdat[1].str = "30479100018530U)*9UU*6 (-(202011719040139058291000";
    pocdat[1].addr = 1234002;
    pocdat[1].func = 1;
    pocdat[1].is_empty = false;
    pocdat[1].len = 0;
//    Serial.println("[LBJ] 测试输出 机车编号 位置 XX°XX′XX″ ");
//    dualPrintf(false,"[LBJ] 测试输出 机车编号 位置 XX°XX′XX″ \n");
    struct lbj_data lbj;

    // db = new data_bond;
    // db->pocsagData[0].addr = 1234000;
    // db->pocsagData[0].str = "37012  15  1504";
    // db->pocsagData[0].func = 1;
    // db->pocsagData[0].is_empty = false;
    // db->pocsagData[0].len = 15;
    // db->pocsagData[1].str = "20202350018530U)*9UU*6 (-(202011719040139058291000";
    // db->pocsagData[1].addr = 1234002;
    // db->pocsagData[1].func = 1;
    // db->pocsagData[1].is_empty = false;
    // db->pocsagData[1].len = 0;
    readDataLBJ(pocdat, &lbj);
    printDataSerial(pocdat, lbj, rxInfo);
    // // appendDataLog(pocdat, lbj, rxInfo);
    // // printDataTelnet(pocdat, lbj, rxInfo);
    // simpleFormatTask();
    // rxInfo.rssi = 0;
    // rxInfo.fer = 0;
    // delete db;
}

int initPager() {// initialize SX1276 with default settings

    int state = radio.beginFSK(434.0, 4.8, 5.0, 12.5);
    RADIOLIB_ASSERT(state)

    state = radio.setGain(1);
    RADIOLIB_ASSERT(state)

    // state = radio.setRxBandwidth(25);
    // RADIOLIB_ASSERT(state)
    // initialize Pager client
    // Serial.print(F("[Pager] Initializing ... "));
    // base (center) frequency: 821.2375 MHz + ppm
    // speed:                   1200 bps
    state = pager.begin(actualFreq(ppm), 1200, false, 2500);
    RADIOLIB_ASSERT(state)

    freq_last = actual_frequency;

    // start receiving POCSAG messages
    // Serial.print(F("[Pager] Starting to listen ... "));
    // address of this "pager": 12340XX
    state = pager.startReceive(pin, 1234000, 0xFFFF0);
    //TODO Enhancement: try to keep a open address filter, we might find something unknown.
    RADIOLIB_ASSERT(state)

    // state = radio.setFrequency(actual_freq);
    // RADIOLIB_ASSERT(state)

    return (state);
}
//endregion

// SETUP
void setup() {
    esp_core_dump_init();
    runtime_timer = millis64();
    esp_reset_reason_t reset_reason = esp_reset_reason();
    initBoard();
    sd1.setFS(SD);
    delay(150);

    initButtons();
    loadRuntimeSettings();
    initMenuSystem();
    initHistoryViewer();
    initIndicatorLed();
    buzzer.begin(BUZZER_PIN);

    // Restore validated local RTC time before starting asynchronous SNTP.
    initTimeService();
    sntp_set_time_sync_notification_cb(timeAvailable);
    sntp_servermode_dhcp(1);
    configTzTime(time_zone, ntpServer1, ntpServer2);

    debugLogInfo("RST: %s\n", printResetReason(reset_reason).c_str());
    if (have_sd) {
        sd1.begin(StoragePaths::Logs);
        sd1.beginCSV(StoragePaths::Records);
        sd1.append("电池电压 %1.2fV\n", battery.readVoltage() * 2);
        sd1.append(2, "调试等级 %d\n", LOG_VERBOSITY);
        sd1.append("复位原因 %s\n", printResetReason(reset_reason).c_str());
        if (getValidLocalTime(&time_info))
            sd1.append("时间来源 %s，时间 %s (UTC+8)\n", systemTimeSource(), fmtime(time_info));
        else
            sd1.append("时间未校准；记录运行时间，日期/时间留空\n");
    }

    // Read-only status check: no automatic SD export or flash erasure.
    checkCoreDumpPresence();

    if (u8g2) {
        u8g2->enableUTF8Print();
        showInitComp();
        u8g2->setFont(FONT_12_GB2312);
        u8g2->setCursor(0, 52);
        u8g2->println("正在初始化");
        u8g2->sendBuffer();
    }

/* SmatPhone配网
#ifdef USE_SMARTCONFIG
    // initialize wireless network.
    Serial.printf("Connecting to WiFi\n");

    Preferences preferences;
    preferences.begin("wifi-config", false);

    String savedSSID = preferences.getString("ssid", "");
    String savedPassword = preferences.getString("password", "");

    if (!savedSSID.isEmpty() && !savedPassword.isEmpty()) {
        if (u8g2) {
            u8g2->setDrawColor(0);
            u8g2->drawBox(0, 42, 128, 14);
            u8g2->setDrawColor(1);
            u8g2->setCursor(0, 52);
            u8g2->println("等待网络连接");
            u8g2->sendBuffer();
        }
        if (!connectToWiFi(savedSSID, savedPassword, 10000)) {
            if (u8g2) {
                u8g2->setDrawColor(0);
                u8g2->drawBox(0, 42, 128, 14);
                u8g2->setDrawColor(1);
                u8g2->setCursor(0, 40);
                u8g2->println("网络连接失败");
                u8g2->setCursor(0, 52);
                u8g2->println("等待配网");
                u8g2->sendBuffer();
            }
            performSmartConfig();
        }
    } else {
        if (u8g2) {
            u8g2->setDrawColor(0);
            u8g2->drawBox(0, 42, 128, 14);
            u8g2->setDrawColor(1);
            u8g2->setCursor(0, 52);
            u8g2->println("等待配网");
            u8g2->sendBuffer();
        }
        performSmartConfig();
    }

    Serial.print("[Network]IP Address: ");
    Serial.println(WiFi.localIP());
    WiFi.setAutoReconnect(true);
    WiFi.persistent(true);
    preferences.putString("ssid", WiFi.SSID());
    preferences.putString("password", WiFi.psk());
    preferences.end();
    wifiSSID = WiFi.SSID();
    wifiPassword = WiFi.psk();
#else
    // initialize wireless network.
    Serial.printf("Connecting to WiFi %s\n", wifiSSID.c_str());
    if (u8g2) {
        u8g2->setDrawColor(0);
        u8g2->drawBox(0, 42, 128, 14);
        u8g2->setDrawColor(1);
        u8g2->drawUTF8(0, 52, "正在连接网络");
        u8g2->sendBuffer();
    }
    connectToWiFi(wifiSSID, wifiPassword, 1000);
#endif

    if (isConnected()) {
        ip = WiFi.localIP();
        // Serial.println();
        Serial.print("[Telnet] ");
        Serial.print(ip);
        Serial.print(":");
        Serial.println(port);
        setupTelnet(); // todo: find another library / modify the code to support multiple client connection.
    } else {
        // Serial.println();
        Serial.println("Error connecting to WiFi, Telnet startup skipped.");
    }
SmatPhone注释结束 */

    initNetworkSettings();

    // Initialize SX1276
    dualPrint("[SX1276] Initializing ... ");
    int state = initPager();
    if (state == RADIOLIB_ERR_NONE) {
        debugLogInfoPrintln(F("success."));
        debugLogInfo("[SX1276] Actual Frequency %f MHz, ppm %.1f\n", actualFreq(ppm), ppm);
    } else {
        debugLogErrorPrint(F("failed, code "));
        debugLogErrorPrintln(state);
        while (true);
    }

//    if(WiFi.getSleep())
//        Serial.println("WIFI Sleep enabled.");

    // start thread watchdog
    esp_task_wdt_init(WDT_TIMEOUT, true);
    esp_task_wdt_add(nullptr);
    // wdt_timer = millis64();

    stopIndicatorLed();
    debugLogInfo("Booting time %llu ms\n", millis64() - runtime_timer);
    sd1.append("启动用时 %llu ms\n", millis64() - runtime_timer);
    runtime_timer = 0;

    initDisplayPower();
    showWaitingScreen();

    // test stuff
    // LBJTEST();
    // auto *test = new uint8_t[32];
    // Serial.printf("[D] test addr %p\n",test);
    // delete[] test;
    // Serial.printf("[D] test addr %p\n",test);
    // test = nullptr;
    // Serial.printf("[D] test addr %p\n",test);
    // delete[] test;
    // delete[] test;
//     Serial.printf("CPU FREQ %d MHz\n",ets_get_cpu_frequency());

}

// Loop functions
void handleTelnetCall() {
    if (give_tel_rssi) {
        telnet.printf("> RSSI %3.2f dBm.\n", radio.getRSSI(false, true));
        give_tel_rssi = false;
        telnet.print("< ");
    }
    if (give_tel_gain) {
        telnet.printf("> Gain Pos %d \n", radio.getGain());
        give_tel_gain = false;
        telnet.print("< ");
    }
    if (tel_set_ppm) {
        int16_t state = radio.setFrequency(actualFreq(ppm));
        if (state == RADIOLIB_ERR_NONE) {
            telnet.printf("> Actual Frequency %f MHz\n", actualFreq(ppm));
            debugLogInfo("[Telnet] > Actual Frequency %f MHz\n", actualFreq(ppm));
        } else {
            telnet.printf("> Failure, Code %d\n", state);
            debugLogError("[Telnet] > Failure, Code %d\n", state);
        }
        telnet.printf("> ppm set to %.f\n", ppm);
        tel_set_ppm = false;
        telnet.print("< ");
    }
}

void handleTelnet() {
    if (!isRemoteConnectionEnabled() || !isConnected()) {
        if (telnet_online) { telnet.stop(); telnet_online = false; }
        return;
    }
    if (!telnet_online) {
        ip = WiFi.localIP();
        debugLogInfo("WIFI Connection to %s established.\n", wifiSSID.c_str());
        debugLogInfoPrint("[Telnet] ");
        debugLogInfoPrint(ip);
        debugLogInfoPrint(":");
        debugLogInfoPrintln(port);
        setupTelnet();
    }
    telnet.loop();
}

void checkNetwork() {
    if (isConnected() && net_timer != 0)
        net_timer = 0;
    else if (!isConnected() && net_timer == 0)
        net_timer = millis64();

    if (!isConnected() && millis64() - net_timer > NETWORK_TIMEOUT && !no_wifi && !is_ap_active) { // 暂定解决方案：超30分钟断wifi
        telnet.stop();
        telnet_online = false;
        WiFi.disconnect();
        WiFiClass::mode(WIFI_OFF);
        debugLogInfoPrintln("WIFI off after 10 minutes without connection.");
        no_wifi = true;
    }

    if (ip_last != WiFi.localIP()) {
        debugLogInfoPrint("Local IP ");
        debugLogInfoPrint(WiFi.localIP());
        debugLogInfoPrint("\n");
    }
    ip_last = WiFi.localIP();
}

// LOOP
void loop() {
    processTimeSync();
    processNetworkSettings();
    updateButtons();
    ButtonEvent buttonEvent;
    while (getNextButtonEvent(buttonEvent)) {
        if (consumeDisplayButton(buttonEvent)) continue;
        if (isHistoryViewerActive()) {
            handleHistoryButtonEvent(buttonEvent);
        } else if (isMenuSystemActive()) {
            handleMenuButtonEvent(buttonEvent);
        } else if (buttonEvent.type == ButtonEventType::ShortPress && buttonEvent.id == ButtonId::Key2) {
            enterHistoryViewer(HistoryEntryDirection::Previous);
        } else if (buttonEvent.type == ButtonEventType::ShortPress && buttonEvent.id == ButtonId::Key3) {
            enterHistoryViewer(HistoryEntryDirection::Next);
        } else {
            handleMenuButtonEvent(buttonEvent);
        }
    }
    updateHistoryViewer();
    updateMenuSystem();
    updateIndicatorLed();

    // reset watchdog
    esp_task_wdt_reset();
    // if (millis64() - wdt_timer >= WDT_RST_PERIOD) {
    //     uint64_t t = esp_timer_get_time() ;
    //     auto r = esp_task_wdt_reset();
    //     t = esp_timer_get_time() - t;
    //     wdt_timer = millis64();
    //     Serial.printf("WDT_RST %d [%llu]\n",r,t);
    // }

    // freqCorrection();
    // Handle carrier timout.
    if (car_timer != 0 && millis64() - car_timer > 700 && prb_timer == 0 && rxInfo.timer == 0) {
        car_count = 0;
        revertFrequency();
        car_fer_last = 0;
        car_timer = 0;
        debugLogVerbose("[D] CARRIER TIMEOUT.\n");
    }

    // Handle preamble timeout.
    if (prb_timer != 0 && millis64() - prb_timer > 600 && rxInfo.timer == 0) {
        prb_count = 0;
        revertFrequency();
        for (auto &i: fers) {
            i = 0;
        }
        prb_timer = 0;
        debugLogVerbose("[D] PREAMBLE TIMEOUT.\n");
    }

    processPendingDisplayUpdate();

    // if task complete, de-initialize
    if (fd_state == TASK_DONE) {
        if (db) acceptModeReception(*db, rxInfo);
        task_fd = nullptr;
        // Serial.printf("[D] NULLPTR [%llu]\n", millis64() - format_task_timer);
        initFmtVars();
        // Serial.printf("[D] INIT VARS [%llu]\n", millis64() - format_task_timer);
        // digitalWrite(BOARD_LED, LED_OFF);
        // Serial.printf("[D] LED LOW [%llu]\n", millis64() - format_task_timer);
        // changeCpuFreq(240);
        // Serial.printf("[D] FREQ CHANGED [%llu]\n", millis64() - format_task_timer);
        fd_state = TASK_INIT;
        format_task_timer = 0;
    } else if (fd_state == TASK_CREATE_FAILED) { // Handle create failure.
        initFmtVars();
        // changeCpuFreq(240);
        format_task_timer = 0;
        fd_state = TASK_INIT;
    }

    handleSerialInput();
    checkNetwork();
    handleTelnet();
    handleTelnetCall();

    if (millis64() > 60000 && format_task_timer == 0 &&
        !exec_init_f80 && !is_ap_active) // lower down frequency 60 sec after startup and idle.
    {
        if (isConnected() || no_wifi) setCpuFrequencyMhz(80);
        else {
            WiFi.mode(WIFI_OFF);
            setCpuFrequencyMhz(80);
            WiFi.mode(WIFI_STA);
            WiFi.begin(); // Use saved credentials, never the example SSID.
        }
        exec_init_f80 = true;
    }

#ifdef HAS_DISPLAY
    // update information on screen.
    { // updateInfo itself protects menu/history screens
        
        if (screen_timer == 0) {
            screen_timer = millis64();
        } else if (millis64() - screen_timer > 3000) { // Set to 3000 to reduce interference.
            // Keep battery checks running even while the OLED is powered down.
            updateInfo();
            screen_timer = millis64();
        }
    }

#endif
    // if (millis64()%5000 == 0){
    //     sd1.append("[D] 当前运行时间 %lu ms.\n",millis64());
    //     sd1.append("[D] 测试输出：\n");
    //     LBJTEST();
    // }

    // if (millis64() - format_task_timer >= 200 && format_task_timer != 0) {
    //     Serial.printf("LED LOW [%llu]\n", millis64() - format_task_timer);
    //     digitalWrite(BOARD_LED, LED_OFF);
    //     if (fd_state == TASK_DONE || fd_state == TASK_INIT) {
    //         format_task_timer = 0;
    //         // changeCpuFreq(240);
    //     }
    // }

    // handle task timeout
    // timeout & running | created
    // todo: simplify this judgement.
    if (millis64() - format_task_timer >= FD_TASK_TIMEOUT &&
        (fd_state == TASK_RUNNING || fd_state == TASK_CREATED || fd_state == TASK_RUNNING_SCREEN) &&
        task_fd != nullptr && format_task_timer != 0) {
        fd_state = TASK_TERMINATED;
        dualPrintln("[Pager] FD_TASK Timeout, waiting for task completion.");
        sd1.append("[Pager] FD_TASK Timeout, waiting for task completion.\n");
        stopIndicatorLed();
        changeCpuFreq(240);
    }
    // else if (millis64() - format_task_timer >= FD_TASK_TIMEOUT && fd_state != TASK_INIT && format_task_timer != 0 &&
    //            fd_state != TASK_RUNNING_SCREEN) { // terminate task while u8g2 operation causes main loop stuck.
    //     Serial.printf("[Pager] Task state %d \n", fd_state);
    //     if (task_fd != nullptr) {
    //         vTaskDelete(task_fd);
    //         task_fd = nullptr;
    //     }
    //     dualPrintln("[Pager] FD_TASK Timeout.");
    //     sd1.append("[Pager] FD_TASK Timeout.\n");
    //     initFmtVars();
    //     Serial.printf("LED LOW [%llu]\n", millis64() - format_task_timer);
    //     digitalWrite(BOARD_LED, LED_OFF);
    //     format_task_timer = 0;
    //     led_timer = 0;
    //     changeCpuFreq(240);
    //     fd_state = TASK_INIT;
    // }

    if (millis64() - timer4 >= 60000 && timer4 != 0 && ets_get_cpu_frequency() != 80) // fCPU to 80 after 60s in idle.
//        setCpuFrequencyMhz(80);
        changeCpuFreq(80);

    handleCarrier();
    handlePreamble();

    handleSync();

    // the number of batches to wait for
    // 2 batches will usually be enough to fit short and medium messages
    if (pager.available() >= 2 && fd_state == TASK_INIT) { // todo add session timeout exception to prevent stuck here.
        // Serial.println("[PHY-LAYER][D] AVAILABLE > 2.");
        setCpuFrequencyMhz(240);
        db_storage = data_bond{};
        db = &db_storage;
        runtime_timer = millis64();
        timer4 = millis64();
        int state = pager.readDataMSA(db->pocsagData, 0);
//        sd1.append("[PHY-LAYER][D] AVAILABLE > 2.\n");
        rxInfo.rssi = rxInfo.cnt > 0 ? rssi_cache / (float) rxInfo.cnt : 0;
        rssi_cache = 0;
        rxInfo.cnt = 0;
        rxInfo.timer = 0;
        prb_timer = 0;
        car_timer = 0;
        // radio.setRxBandwidth(20.8);
        // bandwidth_altered = false;

//        Serial.printf("CPU FREQ TO %d MHz\n",ets_get_cpu_frequency());

        // PagerClient::pocsag_data pocdat[POCDAT_SIZE];
        // struct lbj_data lbj;
        // pd = new PagerClient::pocsag_data[POCDAT_SIZE];

        debugLogVerbose("[D] Prb_count %d\n", prb_count);
        debugLogVerbose("[D] Car_count %d\n", car_count);
        if (prb_count >= 32)
            prb_count = 31;
        if (prb_count > 0)
            rxInfo.fer = fers[prb_count - 1];
        for (int i = 0; i < prb_count; ++i) {
            debugLogVerbose("[D] Fer %.2f Hz\n", fers[i]);
            fers[i] = 0;
        }
        // Serial.printf("[D] Fer %.2f Hz\n", fer);
        // fer = 0;
        prb_count = 0;
        car_count = 0;
        car_fer_last = 0;
        rxInfo.ppm = getBias(actual_frequency);

        Serial.println(F("[Pager] Received pager data, decoding ... "));
        sd1.append(2, "正在解码信号...\n");

        // you can read the data as an Arduino String
        // String str = {};

        if (state == RADIOLIB_ERR_NONE) {
            freq_last = actual_frequency;
//            Serial.printf("success.\n");
            format_task_timer = millis64();

            sd1.append(2, "正在格式化输出...\n");
            // formatDataTask();
            fd_state = TASK_CREATED;
            auto x_ret = xTaskCreatePinnedToCore(formatDataTask, "task_fd",
                                                 FD_TASK_STACK_SIZE, nullptr,
                                                 2, &task_fd, ARDUINO_RUNNING_CORE);
            if (x_ret == pdPASS) {
                delay(1);
            } else if (x_ret == errCOULD_NOT_ALLOCATE_REQUIRED_MEMORY) {
                fd_state = TASK_INIT;
                int x_ret1;
                for (int i = 0; i < FD_TASK_ATTEMPTS; ++i) {
                    fd_state = TASK_CREATED;
                    x_ret1 = xTaskCreatePinnedToCore(formatDataTask, "task_fd",
                                                     FD_TASK_STACK_SIZE, nullptr,
                                                     2, &task_fd, ARDUINO_RUNNING_CORE);
                    if (x_ret1 == pdPASS) {
                        delay(1);
                        break;
                    }
                    fd_state = TASK_INIT;
                    debugLogError("[Pager] FTask failed memory allocation, error %d, mem left %d B, retry %d\n",
                                  x_ret1, esp_get_free_heap_size(), i);
                    sd1.append("[Pager] FTask failed memory allocation, error %d, mem left %d B, retry %d\n",
                               x_ret1, esp_get_free_heap_size(), i);
                }
                if (x_ret1 != pdPASS) {
                    debugLogError("Mem left: %d Bytes\n", esp_get_free_heap_size());
                    dualPrintf(true, "[Pager] Format task memory allocation failure\n");
                    sd1.append("[Pager] Format task memory allocation failure, Mem left %d Bytes\n",
                               esp_get_free_heap_size());
                    fd_state = TASK_CREATE_FAILED;
                    simpleFormatTask();
                    stopIndicatorLed();
                }
            } else {
                fd_state = TASK_INIT;
                dualPrintf(true, "[Pager] Failed to create format task, errcode %d\n", x_ret);
                sd1.append("[Pager] Failed to create format task, errcode %d\n", x_ret);
                fd_state = TASK_CREATE_FAILED;
                stopIndicatorLed();
            }

        } else if (state == RADIOLIB_ERR_MSG_CORRUPT) {
//            Serial.printf("failed.\n");
//            Serial.println("[Pager] Reception failed, too many errors.");
            dualPrintf(true, "[Pager] Reception failed, too many errors. \n");
            revertFrequency();
//            sd1.append("[Pager] Reception failed, too many errors. \n");
        } else {
            // some error occurred
            sd1.append("[Pager] Reception failed, code %d \n", state);
            dualPrintf(true, "[Pager] Reception failed, code %d \n", state);
        }

        // if task was not called.
        if (fd_state == TASK_INIT) {
            initFmtVars();
        } else if (fd_state == TASK_CREATED && task_fd == nullptr) {
            fd_state = TASK_DONE;
        }
    }

    updateRecordingHealth();
    updateUseMode();
    processPendingDisplayUpdate();
    buzzer.update();
    flushDecodedCsvOutputIfDue();
    updateDisplayPower();
    refreshRecordingAlert();
}

void initFmtVars() {
    debugLogVerbose("[Pager] Processing time %llu ms.\n", millis64() - runtime_timer);
    runtime_timer = 0;
    rxInfo.rssi = 0;
    rxInfo.fer = 0;
    rxInfo.ppm = 0;
    // prb_count = 0;
    // for (auto &i: fers) {
    //     i = 0;
    // }
    if (db != nullptr) {
        db->str = "";
        db = nullptr;
    }
}

void formatDataTask(void *pVoid) {
    if (fd_state != TASK_TERMINATED) {
        fd_state = TASK_RUNNING;
    }
    // Serial.printf("[FD-Task] Stack High Mark Begin %u\n", uxTaskGetStackHighWaterMark(nullptr));
    sd1.append(2, "格式化任务已创建\n");

    collectRawPagerData(*db, runtime_timer);
    decodeLbjData(*db, runtime_timer);
    dispatchDecodedOutputs(*db, rxInfo, runtime_timer);
    // Main loop consumes the finished bond before clearing it (mode filtering and display).

    debugLogVerbose("[FD-Task] Stack High Mark %u\n", uxTaskGetStackHighWaterMark(nullptr));
    sd1.append(2, "任务堆栈标 %u\n", uxTaskGetStackHighWaterMark(nullptr));
    // sd1.append("[FD-Task] Stack High Mark %u\n", uxTaskGetStackHighWaterMark(nullptr));
    sd1.append(2, "格式化输出任务完成，用时[%llu]\n", millis64() - runtime_timer);
    task_fd = nullptr;
    fd_state = TASK_DONE;
    vTaskDelete(nullptr);
}

void simpleFormatTask() { // only output initially phrased data in case of memory shortage
    for (auto &i: db->pocsagData) {
        if (i.is_empty)
            continue;
        debugLogVerbose("[D-pDATA] %d/%d: %s\n", i.addr, i.func, i.str.c_str());
        debugLogVerboseSd("[D-pDATA] %d/%d: %s\n", i.addr, i.func, i.str.c_str());
        // db->str = db->str + "  " + i.str;
        db->str += String(i.addr) + "/" + String(i.func) + ":" + i.str + "\n ";
    }
    // pword(db->str.c_str(),20,50);
    displayActivity(runtimeSettings().display.wakeOnArrival);
    processPendingDisplayUpdate();
    showSTR(db->str);
}
// END OF FILE.
